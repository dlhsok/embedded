#include "Driver_SPI.h"
#include "PIN_LPC17xx.h"
#include "GPIO_LPC17xx.h"
#include "oled.h"


#define XLevelL		0x00
#define XLevelH		0x10
#define XLevel	    ((XLevelH&0x0F)*16+XLevelL)
#define Max_Column	132
#define Max_Row		64
#define	Brightness	0xCF 
#define X_WIDTH 	132
#define Y_WIDTH 	64
#define   time      1

//extern ARM_DRIVER_SPI Driver_SPI0;
//static ARM_DRIVER_SPI * SPI0drv = &Driver_SPI0;

//static char spidone = 0;

void mySPI_callback(uint32_t event)
{
  switch (event)    
	{    
		case ARM_SPI_EVENT_TRANSFER_COMPLETE:                          
			/* Success: Wakeup Thread */        
//			spidone = 0;
			break;    
		case ARM_SPI_EVENT_DATA_LOST:        
			/*  Occurs in slave mode when data is requested/sent by master            
			but send/receive/transfer operation has not been started            
			and indicates that data is lost. */                    
			/* Error: Call debugger or replace with custom error handling */        
			break;
		
	case ARM_SPI_EVENT_MODE_FAULT:        
			/*  Occurs in master mode when Slave Select is deactivated and
			indicates Master Mode Fault. */                    
			/* Error: Call debugger or replace with custom error handling */        
			break;    
	}
}

/************************************6*8的点阵************************************/
uchar FASIIC[][6] =		
{
0x00, 0x00, 0x00, 0x00, 0x00, 0x00,// sp
0x00, 0x00, 0x00, 0x2f, 0x00, 0x00,// !
0x00, 0x00, 0x07, 0x00, 0x07, 0x00,// "
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0x14, 0x14, 0x14, 0x14, 0x14, 0x14,// horiz lines
};

void LCD_DLY_ms(unsigned int ms)
{                         
  uint i,j;
	for(i=0;i<ms;i++)
		for(j=0;j<24000;j++);
}

void oledinit(void)
{
	//OLED DC
	PIN_Configure(0, 22, PIN_FUNC_0, PIN_PINMODE_PULLDOWN, PIN_PINMODE_NORMAL);
	GPIO_SetDir(0, 22, GPIO_DIR_OUTPUT);
	GPIO_PinWrite(0, 22, 0);

	//OLED RST
	PIN_Configure(2, 6, PIN_FUNC_0, PIN_PINMODE_PULLDOWN, PIN_PINMODE_NORMAL);
	GPIO_SetDir(2, 6, GPIO_DIR_OUTPUT);
	GPIO_PinWrite(2, 6, 1);
	GPIO_PinWrite(2, 6, 0);
	LCD_DLY_ms(20);
	GPIO_PinWrite(2, 6, 1);

	//OLED CS
	PIN_Configure(0, 16, PIN_FUNC_0, PIN_PINMODE_PULLDOWN, PIN_PINMODE_NORMAL);
	GPIO_SetDir(0, 16, GPIO_DIR_OUTPUT);
	GPIO_PinWrite(0, 16, 1);

	//OLED SCK
	PIN_Configure(0, 15, PIN_FUNC_0, PIN_PINMODE_PULLDOWN, PIN_PINMODE_NORMAL);
	GPIO_SetDir(0, 15, GPIO_DIR_OUTPUT);
	GPIO_PinWrite(0, 15, 1);

	//OLED MOSI
	PIN_Configure(0, 18, PIN_FUNC_0, PIN_PINMODE_PULLDOWN, PIN_PINMODE_NORMAL);
	GPIO_SetDir(0, 18, GPIO_DIR_OUTPUT);
	GPIO_PinWrite(0, 18, 1);

//	SPI0drv->Initialize(mySPI_callback);
//	SPI0drv->PowerControl(ARM_POWER_FULL);
//	SPI0drv->Control(ARM_SPI_MODE_MASTER | ARM_SPI_CPOL0_CPHA0 | ARM_SPI_MSB_LSB | ARM_SPI_SS_MASTER_SW | ARM_SPI_DATA_BITS(8), 10000);
	LCD_CS_1();
		LCD_DLY_ms(100);

}

/*********************OLED驱动程序用的延时程序************************************/

/*********************LCD写数据************************************/ 
unsigned char spi_txbuf[100];
void LCD_WrDat(unsigned char dat)	 
{
	unsigned char i;
	spi_txbuf[0] = dat;
	LCD_DC_1();
//	spidone = 1;
//	SPI0drv->Send(spi_txbuf, 1);
//	while(spidone);
	 for(i=0;i<8;i++) //???????? 
 {
  if(dat&0x80)
  {
    LCD_MOSI_1();  
  }
  else
  {
  LCD_MOSI_0();  
  }  

//  LCD_DLY_ms(time);
  LCD_CLK_0();
  LCD_DLY_ms(time);
  LCD_CLK_1();
  LCD_DLY_ms(time);
  dat<<=1;
 }
}
/*********************LCD写命令************************************/										
void LCD_WrCmd(unsigned char cmd)
{
	unsigned char i;
	spi_txbuf[0] = cmd;
	LCD_DC_0();
//	spidone = 1;
//	SPI0drv->Send(spi_txbuf, 1);
//	while(spidone);
 for(i=0;i<8;i++) //???????? 
 {
  if(cmd&0x80)
  {
    LCD_MOSI_1();  
  }
  else
  {
  LCD_MOSI_0();  
  }  

//  LCD_DLY_ms(time);
  LCD_CLK_0();
  LCD_DLY_ms(time);
  LCD_CLK_1();
  LCD_DLY_ms(time);
  cmd<<=1;
 }
}
/*********************LCD 设置坐标************************************/
void LCD_Set_Pos(unsigned char x, unsigned char y) 
{ 
LCD_WrCmd(0xb0+y);
LCD_WrCmd(((x&0xf0)>>4)|0x10);
LCD_WrCmd((x&0x0f)|0x01); 
} 
/*********************LCD全屏************************************/
void LCD_Fill(unsigned char bmp_dat) 
{
unsigned char y,x;
for(y=0;y<8;y++)
{
LCD_WrCmd(0xb0+y);
LCD_WrCmd(0x01);
LCD_WrCmd(0x10);
for(x=0;x<X_WIDTH;x++)
LCD_WrDat(bmp_dat);
}
}
/*********************LCD复位************************************/
void LCD_CLS(void)
{
unsigned char y,x;	
for(y=0;y<8;y++)
{
LCD_WrCmd(0xb0+y);
LCD_WrCmd(0x01);
LCD_WrCmd(0x10); 
for(x=0;x<X_WIDTH;x++)
LCD_WrDat(0);
}
}
/*********************LCD初始化************************************/
void OLED_Init(void)     
{
  oledinit();
  LCD_DLY_ms(2000);
	LCD_CS_0();
	LCD_WrCmd(0xae);//--turn off oled panel
	LCD_WrCmd(0x00);//---set low column address
	LCD_WrCmd(0x10);//---set high column address
	LCD_WrCmd(0x40);//--set start line address  Set Mapping RAM Display Start Line (0x00~0x3F)
	LCD_WrCmd(0x81);//--set contrast control register
	LCD_WrCmd(0xcf); // Set SEG Output Current Brightness
	LCD_WrCmd(0xa1);//--Set SEG/Column Mapping     0xa0左右反置 0xa1正常
	LCD_WrCmd(0xc8);//Set COM/Row Scan Direction   0xc0上下反置 0xc8正常
	LCD_WrCmd(0xa6);//--set normal display
	LCD_WrCmd(0xa8);//--set multiplex ratio(1 to 64)
	LCD_WrCmd(0x3f);//--1/64 duty
	LCD_WrCmd(0xd3);//-set display offset	Shift Mapping RAM Counter (0x00~0x3F)
	LCD_WrCmd(0x00);//-not offset
	LCD_WrCmd(0xd5);//--set display clock divide ratio/oscillator frequency
	LCD_WrCmd(0x80);//--set divide ratio, Set Clock as 100 Frames/Sec
	LCD_WrCmd(0xd9);//--set pre-charge period
	LCD_WrCmd(0xf1);//Set Pre-Charge as 15 Clocks & Discharge as 1 Clock
	LCD_WrCmd(0xda);//--set com pins hardware configuration
	LCD_WrCmd(0x12);
	LCD_WrCmd(0xdb);//--set vcomh
	LCD_WrCmd(0x40);//Set VCOM Deselect Level
	LCD_WrCmd(0x20);//-Set Page Addressing Mode (0x00/0x01/0x02)
	LCD_WrCmd(0x02);//
	LCD_WrCmd(0x8d);//--set Charge Pump enable/disable
	LCD_WrCmd(0x14);//--set(0x10) disable
	LCD_WrCmd(0xa4);// Disable Entire Display On (0xa4/0xa5)
	LCD_WrCmd(0xa6);// Disable Inverse Display On (0xa6/a7) 
	LCD_WrCmd(0xaf);//--turn on oled panel
	LCD_Fill(0x00);  //初始清屏
	LCD_Set_Pos(0,0); 	
	LCD_CS_1();
} 


/***************功能描述：显示6*8一组标准ASCII字符串	显示的坐标（x,y），y为页范围0～7****************/
void LCD_P6x8Str(uchar x,uchar y,uchar ch[])
{
	unsigned char c=0,i=0,j=0;
	LCD_CS_0();
	while (ch[j]!='\0')
	{
		c =ch[j]-32;
		if(x>126){x=0;y++;}
		LCD_Set_Pos(x,y);
		for(i=0;i<6;i++)
		LCD_WrDat(FASIIC[c][i]);
		x+=6;
		j++;
	}
	LCD_CS_1();
}

void LCD_shuzi(uchar x,uchar y,uchar ch)
{
	unsigned char c=0,i=0;
	LCD_CS_0();
		c =ch+16;
		LCD_Set_Pos(x,y);
		for(i=0;i<6;i++)
		LCD_WrDat(FASIIC[c][i]);
	LCD_CS_1();
}

